## pmsysv2_build/Kconfig/Kconfig.shield
```kconfig
osource "c:/users/abdelali/desktop/ble-pressure/boards/shields/*/Kconfig.shield"
osource "C:/ncs/v2.5.2/nrf/boards/shields/*/Kconfig.shield"
```

## pmsysv2_build/Kconfig/Kconfig.shield.defconfig
```kconfig
osource "c:/users/abdelali/desktop/ble-pressure/boards/shields/*/Kconfig.defconfig"
osource "C:/ncs/v2.5.2/nrf/boards/shields/*/Kconfig.defconfig"
```
